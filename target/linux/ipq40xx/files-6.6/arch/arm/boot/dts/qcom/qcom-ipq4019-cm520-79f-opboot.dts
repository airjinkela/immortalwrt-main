// SPDX-License-Identifier: GPL-2.0-or-later OR MIT

#include "qcom-ipq4019-cm520-79f.dts"

/ {
	model = "MobiPromo CM520-79F";
	compatible = "mobipromo,cm520-79f";

	chosen {
		bootargs-append = " ubi.block=0,1 root=/dev/ubiblock0_1";
	};
};

&root_part {
	label = "rootfs";
};
