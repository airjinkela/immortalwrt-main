// SPDX-License-Identifier: GPL-2.0-or-later OR MIT

/dts-v1/;

#include "mt7981b-nokia-ea0326gmp.dts"

/ {
	model = "Nokia EA0326GMP (UBoot mod)";
	compatible = "nokia,ea0326gmp-mod", "mediatek,mt7981";

};

&spi_nand {
	mediatek,nmbm;
	mediatek,bmt-max-ratio = <1>;
	mediatek,bmt-max-reserved-blocks = <64>;
	partitions {
		partition@980000 {
			reg = <0x980000 0x6e00000>;
		};
	};

};
