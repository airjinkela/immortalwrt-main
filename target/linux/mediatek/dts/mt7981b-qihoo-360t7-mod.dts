// SPDX-License-Identifier: GPL-2.0-or-later OR MIT

/dts-v1/;

#include "mt7981b-qihoo-360t7-base.dtsi"

/ {
	model = "Qihoo 360T7  (UBoot mod)";
	compatible = "qihoo,360t7-mod", "mediatek,mt7981";
};

&spi_nand {
	mediatek,nmbm;
	mediatek,bmt-max-ratio = <1>;
	mediatek,bmt-max-reserved-blocks = <64>;
};

&partitions {
	partition@580000 {
		label = "ubi";
		reg = <0x580000 0x6c00000>;
	};
};